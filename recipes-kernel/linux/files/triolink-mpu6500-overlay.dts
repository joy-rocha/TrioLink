/dts-v1/;
/plugin/;

/ {
    compatible = "brcm,bcm2712";

    fragment@0 {
        target = <&i2c1>;
        __overlay__ {
            #address-cells = <1>;
            #size-cells = <0>;
            status = "okay";

            mpu6500: mpu6500@68 {
                compatible = "invensense,mpu6500";
                reg = <0x68>;
                status = "okay";
            };
        };
    };
};