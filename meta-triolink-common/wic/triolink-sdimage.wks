## meta-triolink-systemd/conf/distro/triolink-systemd.conf
```bitbake
require conf/distro/poky.conf
require conf/distro/include/triolink-common.inc

DISTRO = "triolink-systemd"
DISTRO_NAME = "TrioLink (systemd)"
DISTRO_VERSION = "1.0"

INIT_MANAGER = "systemd"
```

## meta-triolink-sysvinit/conf/distro/triolink-sysvinit.conf
```bitbake
require conf/distro/poky.conf
require conf/distro/include/triolink-common.inc

DISTRO = "triolink-sysvinit"
DISTRO_NAME = "TrioLink (sysvinit)"
DISTRO_VERSION = "1.0"

INIT_MANAGER = "sysvinit"
```
